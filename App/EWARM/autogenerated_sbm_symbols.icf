
/* *** THIS IS AN AUTO-GENERATED FILE - DO NOT EDIT (OR MOVE) THIS FILE: YOUR CHANGES WILL BE OVERWRITTEN *** */

/* SBM SYMBOLS - FLASH */
define exported symbol STZ_ADDR_EXECUTABLE_START           = 0x8040000;
define exported symbol STZ_ADDR_EXECUTABLE_END             = 0x80fffff;
define exported symbol STZ_ADDR_UPDATE_START               = 0x8100000;
define exported symbol STZ_ADDR_UPDATE_END                 = 0x81dffff;
define exported symbol STZ_ADDR_MUH_START                  = 0x8020000;
define exported symbol STZ_ADDR_MUH_END                    = 0x803ffff;
define exported symbol STZ_ADDR_SBM_START                  = 0x8000000;
define exported symbol STZ_ADDR_SBM_END                    = 0x801ffff;
define exported symbol STZ_ADDR_PDOR_START                 = 0x8000298;
define exported symbol STZ_ADDR_PDOR_END                   = 0x800029b;
define exported symbol STZ_ADDR_SECAPI_ACCESS_WINDOW_START = 0x80002c0;
define exported symbol STZ_ADDR_SECAPI_ACCESS_WINDOW_END   = 0x80002c3;

/* SBM SYMBOLS - RAM */
define exported symbol STZ_ADDR_SBM_PERSISTENT_RAM_START   = 0x2001f800;
define exported symbol STZ_ADDR_SBM_PERSISTENT_RAM_END     = 0x2001ffff;
define exported symbol STZ_ADDR_APPLICATION_RAM_START      = 0x20000000;
define exported symbol STZ_ADDR_APPLICATION_RAM_END        = 0x2001f7ff;
