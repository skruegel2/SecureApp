include "autogenerated_sbm_symbols.icf";

define exported symbol STZ_ADDR_ROM_START = 0x8000000;
define exported symbol STZ_ADDR_ROM_END   = 0x81fffff;
define exported symbol STZ_ADDR_RAM_START = 0x20000000;
define exported symbol STZ_ADDR_RAM_END   = 0x2001ffff;

define symbol CSTACK_SIZE = 0x1000;

/////////////////////////
// Generic Config Section
/////////////////////////
define memory mem with size = 4G;

define region ROM_sbm_region = mem:[from STZ_ADDR_SBM_START to STZ_ADDR_SBM_END];
define region RAM_region = mem:[from STZ_ADDR_RAM_START to STZ_ADDR_RAM_END];

define block CSTACK with alignment = 8, size = CSTACK_SIZE { };
define symbol STZ_ADDR_SECAPI_ACCESS_WINDOW_size = STZ_ADDR_SECAPI_ACCESS_WINDOW_END - STZ_ADDR_SECAPI_ACCESS_WINDOW_START + 1;
define block SECAPI_ACCESS_BLOCK with fixed order, size = STZ_ADDR_SECAPI_ACCESS_WINDOW_size
                                                  { section SECAPI_ACCESS_POINTER };

initialize by copy { readwrite };
do not initialize  { section .noinit };

place at address mem:STZ_ADDR_SBM_START {readonly section .intvec};
place at address mem:STZ_ADDR_PDOR_START {readonly section PDOR };
place at address mem:STZ_ADDR_SECAPI_ACCESS_WINDOW_START { block SECAPI_ACCESS_BLOCK };

place in ROM_sbm_region { readonly };
define symbol SBM_EPHEMERAL_RAM_size = STZ_ADDR_APPLICATION_RAM_END - STZ_ADDR_APPLICATION_RAM_START + 1;
define symbol SBM_PERSISTENT_RAM_size = STZ_ADDR_SBM_PERSISTENT_RAM_END - STZ_ADDR_SBM_PERSISTENT_RAM_START + 1;
define block SBM_EPHEMERAL_RAM with alignment = 8, size = SBM_EPHEMERAL_RAM_size
                                                  { section EPHEMERAL_RAM,
                                                    block CSTACK };


define block SBM_PERSISTENT_RAM with alignment = 8, size = SBM_PERSISTENT_RAM_size
                                                   { readwrite,
                                                     section PERSISTENT_RAM };

place at address mem:STZ_ADDR_SBM_PERSISTENT_RAM_START { block SBM_PERSISTENT_RAM };
place at address mem:STZ_ADDR_APPLICATION_RAM_START    { block SBM_EPHEMERAL_RAM  };
